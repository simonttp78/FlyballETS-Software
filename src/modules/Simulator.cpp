// file:	Simulator.cpp
//
// summary:	Implements the simulator class. Since this class is memory intensive, it should only be
// included if actual simulation is wished.
#include "Simulator.h"
#include "RaceHandler.h"
#include "PROGMEM_readAnything.h"

/// <summary>
///   Initialises this object.
/// </summary>
///
void SimulatorClass::init()
{
   _iDataPos = 0;
   _iDataStartPos = _iDataStartPos = calculateDataStartPos(0);
   _iDataEndPos = _iNumberOfRecordsInSimulatedRace[0];
   PROGMEM_readAnything(&SimulatorQueue[_iDataPos], PendingRecord);
   log_i("Simulated Race 0 selected!");
}

/// <summary>
///   Main entry-point for this application. Should be called every main loop cycle if simulation is wished.
/// </summary>
void SimulatorClass::Main()
{
   if (bExecuteSimRaceReset)
   {
      if (_iDataPos != _iDataStartPos)
      {
         // We've reset a race, reset data position to 0
         _iDataPos = _iDataStartPos;
         PROGMEM_readAnything(&SimulatorQueue[_iDataPos], PendingRecord);
         _bNoMoreValidTriggers = false;
      }
      bExecuteSimRaceReset = false;
      return;
   }

   if (bExecuteSimRaceChange)
   {
      if (RaceHandler.RaceState == RaceHandler.STOPPED || RaceHandler.RaceState == RaceHandler.RESET)
      {
         _iDataStartPos = calculateDataStartPos(iSimulatedRaceID);
         _iDataPos = _iDataStartPos;
         _iDataEndPos = _iDataPos + _iNumberOfRecordsInSimulatedRace[iSimulatedRaceID];
         PROGMEM_readAnything(&SimulatorQueue[_iDataPos], PendingRecord);
         _bNoMoreValidTriggers = false;
         log_i("Simulated Race %i selected!", iSimulatedRaceID);
      }
      bExecuteSimRaceChange = false;
      return;
   }

   if (_iDataPos == _iDataEndPos)
   {
      // Pending record doesn't contain valid data, this means we've reched the end of our queue
      _bNoMoreValidTriggers = true;
      return;
   }
   // Simulate sensors
   else if (!_bNoMoreValidTriggers)
   {
      while (RaceHandler.RaceState != RaceHandler.RESET && !RaceHandler.bIgnoreSensors && PendingRecord.llSimTriggerTime != 0
               && _iDataPos < _iDataEndPos && (PendingRecord.llSimTriggerTime + 3000000) <= (long)((MICROS - RaceHandler.llRaceStartTime) + 3000000))
      {
         log_v("Pending record");
         RaceHandler._QueuePush({PendingRecord.iSimSensorNumber, (long long)(RaceHandler.llRaceStartTime + PendingRecord.llSimTriggerTime), PendingRecord.iSimState});
         _iDataPos++;
         PROGMEM_readAnything(&SimulatorQueue[_iDataPos], PendingRecord);
      }
   }
}

uint SimulatorClass::calculateDataStartPos(uint iSimulatedRaceID)
{
   uint iDataStartPos = 0;
   if (iSimulatedRaceID != 0)
   {
      for (u_int8_t i = 0; i < iSimulatedRaceID; i++)
	      iDataStartPos = iDataStartPos + _iNumberOfRecordsInSimulatedRace[i];
   }   
   return iDataStartPos;
}

/// <summary>
///   Program the interrupt triggers which should be simulated here. See end of file for a collection of records from actual races.
/// </summary>
const SimulatorClass::SimulatorRecord SimulatorClass::SimulatorQueue[] PROGMEM = {
   // TestCase 0 (56) --> Race3 (GT Team 4):
   {1, -102316, 1},
   {2, -87824, 1},
   {2, -80456, 0},
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   {1, 34767820, 0},
   // TestCase 1
   {1, 30249, 1},
   {2, 77339, 1},
   {1, 121961, 0},
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   {1, 16766664, 0},
   // TestCase 2
   {1, 49140, 1},
   {2, 90878, 1},
   {1, 128477, 0},
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   {1, 16573259, 0},
   // TestCase 3
   {1, 49140, 1},
   {2, 90878, 1},
   {1, 128477, 0},
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   {1, 16573259, 0},
   // TestCase 4
   {1, 49140, 1},
   {2, 90878, 1},
   {1, 128477, 0},
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   {1, 16573259, 0},
   // TestCase 5
   {1, -708022, 1},
   {2, -668627, 1},
   {1, -635783, 0},
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   {1, 23057043, 0},
   // TestCase 6
   {1, -312563, 1},
   {2, -265863, 1},
   {1, -226969, 0},
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   {1, 25917047, 0},
   // TestCase 7
   {1, -284207, 1},
   {2, -244937, 1},
   {1, -206705, 0},
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   {1, 22089903, 0},
   // TestCase 8
   {1, -183571, 1},
   {2, -139641, 1},
   {1, -100800, 0},
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   {1, 27200596, 0},
   // TestCase 9
   {1, -133962, 1},
   {2, -87647, 1},
   {1, -51148, 0},
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   {1, 27345537, 0}
};
/// <summary>
/// The simulator class object.
/// </summary>
SimulatorClass Simulator;
